## sdkconfig.defaults
```kconfig
# ===================== 芯片 =====================
CONFIG_IDF_TARGET="esp32s3"

# ===================== Flash / 分区（C++ 版布局）=====================
CONFIG_ESPTOOLPY_FLASHSIZE_16MB=y
CONFIG_ESPTOOLPY_FLASHMODE_QIO=y
CONFIG_ESPTOOLPY_FLASHFREQ_80M=y
CONFIG_PARTITION_TABLE_CUSTOM=y
CONFIG_PARTITION_TABLE_CUSTOM_FILENAME="partitions.csv"

# ===================== PSRAM（照抄 C++ 工程：8MB OCT 80MHz）=====================
CONFIG_SPIRAM=y
CONFIG_SPIRAM_MODE_OCT=y
CONFIG_SPIRAM_TYPE_AUTO=y
CONFIG_SPIRAM_CLK_IO=30
CONFIG_SPIRAM_CS_IO=26
CONFIG_SPIRAM_SPEED_80M=y
CONFIG_SPIRAM_BOOT_HW_INIT=y
CONFIG_SPIRAM_BOOT_INIT=y
CONFIG_SPIRAM_PRE_CONFIGURE_MEMORY_PROTECTION=y
CONFIG_SPIRAM_USE_MALLOC=y
CONFIG_SPIRAM_MALLOC_ALWAYSINTERNAL=1024
CONFIG_SPIRAM_MALLOC_RESERVE_INTERNAL=102400
CONFIG_SPIRAM_ALLOW_STACK_EXTERNAL_MEMORY=y

# ===================== 系统 =====================
CONFIG_ESP_MAIN_TASK_STACK_SIZE=8192
CONFIG_FREERTOS_HZ=1000
CONFIG_LOG_DEFAULT_LEVEL_INFO=y
CONFIG_ESP_DEFAULT_CPU_FREQ_MHZ_240=y

# ===================== 内存优化（照抄 C++ 工程）=====================
# 让 mbedtls(TLS) 的大块内存分配到 PSRAM，内部 RAM 留给 WiFi/AFE/DMA
CONFIG_MBEDTLS_EXTERNAL_MEM_ALLOC=y
CONFIG_MBEDTLS_DYNAMIC_FREE_CONFIG_DATA=y
CONFIG_SPIRAM_MEMTEST=n
# WiFi / LWIP 缓冲调小，省内部 RAM
CONFIG_ESP_WIFI_STATIC_RX_BUFFER_NUM=3
CONFIG_ESP_WIFI_DYNAMIC_RX_BUFFER_NUM=6
CONFIG_ESP_WIFI_RX_BA_WIN=3
CONFIG_LWIP_TCPIP_RECVMBOX_SIZE=16
CONFIG_ESP32S3_INSTRUCTION_CACHE_32KB=y
CONFIG_ESP32S3_DATA_CACHE_LINE_64B=y

# ===================== 语音唤醒（照抄 C++ 配置）=====================
# 唤醒词模型："你好小智"
CONFIG_SR_WN_WN9_NIHAOXIAOZHI_TTS=y
CONFIG_SR_NSN_WEBRTC=y
CONFIG_SR_VADN_WEBRTC=y
CONFIG_MODEL_IN_FLASH=y
CONFIG_USE_AFE_WAKE_WORD=y
CONFIG_USE_AUDIO_PROCESSOR=y

# ===================== 小智组件 =====================
CONFIG_XIAOZHI_AUDIO_TASK_STACK_SIZE=4096

# ===================== LVGL =====================
CONFIG_LV_COLOR_DEPTH_16=y
CONFIG_LV_FONT_MONTSERRAT_24=y
CONFIG_LV_FONT_MONTSERRAT_14=y
CONFIG_LV_FONT_SOURCE_HAN_SANS_SC_16_CJK=y
CONFIG_LV_USE_FS_MEMFS=y
CONFIG_LV_FS_MEMFS_LETTER=65

# 摄像头 DMA 节点缓冲放 PSRAM，给内部 RAM 留空间给屏幕 SPI DMA
CONFIG_CAMERA_PSRAM_DMA=y
CONFIG_CAMERA_DMA_BUFFER_SIZE_MAX=16384
```
